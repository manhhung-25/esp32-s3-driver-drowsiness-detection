## main/Kconfig.projbuild
```kconfig
# ============================================================================
# Kconfig.projbuild - Driver Drowsiness Detection
# ============================================================================

menu "Drowsiness Detection Configuration"

    # ----------------------------------------------------------
    # Camera pinout
    # ----------------------------------------------------------
    choice DROWSY_CAM_MODULE
        prompt "Camera board preset"
        default DROWSY_CAM_MODULE_ESP32_S3_EYE
        help
            Select camera board pinout preset or CUSTOM.

    config DROWSY_CAM_MODULE_ESP32_S3_EYE
        bool "ESP32-S3-EYE (OV2640)"
        help
            Default pinout for ESP32-S3-EYE board.

    config DROWSY_CAM_MODULE_AI_THINKER
        bool "AI-Thinker ESP32-CAM (OV2640)"
        help
            Default pinout for AI-Thinker ESP32-CAM board.

    config DROWSY_CAM_MODULE_CUSTOM
        bool "Custom board"
        help
            Manually specify camera pinout options below.

    endchoice

    # ---- Pins for custom board ----
    config DROWSY_CAM_PIN_PWDN
        int "Camera PWDN pin (custom)"
        default -1
    config DROWSY_CAM_PIN_RESET
        int "Camera RESET pin (custom)"
        default -1
    config DROWSY_CAM_PIN_XCLK
        int "Camera XCLK pin (custom)"
        default 15
    config DROWSY_CAM_PIN_SIOD
        int "Camera SIOD (SDA) pin (custom)"
        default 4
    config DROWSY_CAM_PIN_SIOC
        int "Camera SIOC (SCL) pin (custom)"
        default 5
    config DROWSY_CAM_PIN_Y9
        int "Camera D7 (Y9) pin (custom)"
        default 16
    config DROWSY_CAM_PIN_Y8
        int "Camera D6 (Y8) pin (custom)"
        default 17
    config DROWSY_CAM_PIN_Y7
        int "Camera D5 (Y7) pin (custom)"
        default 18
    config DROWSY_CAM_PIN_Y6
        int "Camera D4 (Y6) pin (custom)"
        default 12
    config DROWSY_CAM_PIN_Y5
        int "Camera D3 (Y5) pin (custom)"
        default 10
    config DROWSY_CAM_PIN_Y4
        int "Camera D2 (Y4) pin (custom)"
        default 8
    config DROWSY_CAM_PIN_Y3
        int "Camera D1 (Y3) pin (custom)"
        default 9
    config DROWSY_CAM_PIN_Y2
        int "Camera D0 (Y2) pin (custom)"
        default 11
    config DROWSY_CAM_PIN_VSYNC
        int "Camera VSYNC pin (custom)"
        default 6
    config DROWSY_CAM_PIN_HREF
        int "Camera HREF pin (custom)"
        default 7
    config DROWSY_CAM_PIN_PCLK
        int "Camera PCLK pin (custom)"
        default 13

    # ----------------------------------------------------------
    # Camera resolution
    # ----------------------------------------------------------
    choice DROWSY_FRAME_SIZE
        prompt "Camera frame size"
        default DROWSY_FRAME_SIZE_240X240
        help
            Camera resolution.
            - 240x240: Default - stable performance.
            - QVGA 320x240: Wide angle.

    config DROWSY_FRAME_SIZE_240X240
        bool "240x240 (Recommended)"
    config DROWSY_FRAME_SIZE_QVGA
        bool "QVGA 320x240"
    endchoice

    config DROWSY_CAM_RGB565_BE
        bool "RGB565 big-endian format"
        default y if DROWSY_CAM_MODULE_ESP32_S3_EYE
        default n
        help
            The connected OV2640 requires big-endian RGB565. Enable only when
            its captured image and face detector both confirm this byte order.

    # ----------------------------------------------------------
    # Alarm GPIO
    # ----------------------------------------------------------
    config DROWSY_BUZZER_GPIO
        int "Buzzer GPIO"
        default 14
        help
            Buzzer pin (LEDC PWM 2kHz).

    config DROWSY_LED_GPIO
        int "Warning LED GPIO"
        default 21
        help
            Warning LED pin (GPIO output).

    # ----------------------------------------------------------
    # PFLD model configuration
    # ----------------------------------------------------------
    choice DROWSY_PFLD_MODEL
        prompt "PFLD landmark model"
        default DROWSY_PFLD_68PT
        help
            Select landmark model embedded in firmware.

        config DROWSY_PFLD_68PT
            bool "68 points (iBUG/300-W) - model/pfld68.espdl"

        config DROWSY_PFLD_98PT
            bool "98 points (WFLW) - model/pfld_landmarks_98.espdl"
    endchoice

    config DROWSY_PFLD_NUM_POINTS
        int
        default 68 if DROWSY_PFLD_68PT
        default 98 if DROWSY_PFLD_98PT

    config DROWSY_PFLD_MODEL_FILE
        string
        default "pfld68.espdl" if DROWSY_PFLD_68PT
        default "pfld_landmarks_98.espdl" if DROWSY_PFLD_98PT

    config DROWSY_PFLD_MEAN
        int "PFLD input mean (0-255)"
        default 0
        help
            PFLD input normalization mean.

    config DROWSY_PFLD_STD
        int "PFLD input std (0-255)"
        default 255
        help
            PFLD input normalization std.

    config DROWSY_PFLD_RGB_SWAP
        bool "PFLD model expects BGR (rgb_swap)"
        default n
        help
            Enable if landmark model was trained on BGR images.

    config DROWSY_AI_SAMPLE_EVERY_N
        int "Camera frames between AI samples"
        default 2
        range 1 6
        help
            Runs face/PFLD only on the newest available sample. Other camera
            frames remain available to the web stream.

    # ----------------------------------------------------------
    # Drowsiness detection thresholds
    # ----------------------------------------------------------
    config DROWSY_EAR_BLINK_TH
        int "EAR blink threshold (x1000)"
        default 200
        help
            EAR below this value indicates eye blink. (200 = 0.200)

    config DROWSY_EAR_DROWSY_TH
        int "EAR drowsy threshold (x1000)"
        default 160
        help
            Sustained EAR below this value indicates drowsy eye close.

    config DROWSY_MAR_TH
        int "MAR yawn threshold (x1000)"
        default 500
        help
            MAR above this threshold indicates open mouth / yawn.

    config DROWSY_MICROSLEEP_MS
        int "Microsleep time (ms)"
        default 1200
        help
            Continuous eye closure duration in ms to trigger MICROSLEEP alarm.

    config DROWSY_PERCLOS_TH
        int "PERCLOS threshold (x1000, 400 = 40%)"
        default 400
        help
            Percentage of eye closure within sliding window to trigger DROWSY.

    config DROWSY_WINDOW_MS
        int "PERCLOS window (ms)"
        default 60000
        help
            Sliding window size in ms for PERCLOS calculation.

    config DROWSY_BLINK_RATE_HIGH
        int "High blink rate (blinks/min)"
        default 20
        help
            Blink rate per minute threshold.

    config DROWSY_PITCH_DEV_TH
        int "Head pitch deviation threshold (x1000)"
        default 120
        help
            Pitch deviation threshold from baseline.

    config DROWSY_DISTRACT_YAW_TH
        int "Head yaw distraction threshold (x1000)"
        default 220
        help
            Absolute yaw above this value is treated as attention off road.

    config DROWSY_FACE_LOST_MS
        int "Face lost grace time (ms)"
        default 800
        help
            Continuous no-face time before it contributes to distraction.

    config DROWSY_DISTRACT_MS
        int "Distraction duration (ms)"
        default 2000
        help
            Sustained turned head or no visible face duration before warning.

    config DROWSY_FPS_LOG_INTERVAL_S
        int "FPS log interval (s)"
        default 5
        help
            Log interval in seconds for FPS output.

    # ----------------------------------------------------------
    # Console
    # ----------------------------------------------------------
    config DROWSY_CONSOLE_ENABLE
        bool "Enable runtime console (drowsy get/set/stats/reset)"
        default y
        help
            Enable runtime serial console commands.

    # ----------------------------------------------------------
    # Web monitor
    # ----------------------------------------------------------
    config DROWSY_WEB_ENABLE
        bool "Enable web monitor (WiFi + MJPEG stream + /status)"
        default y
        help
            Enable web server and streaming interface.

    choice DROWSY_WIFI_MODE
        prompt "WiFi mode"
        default DROWSY_WIFI_MODE_AP
        depends on DROWSY_WEB_ENABLE
        help
            WiFi mode selection: AP, STA, or OFF.

    config DROWSY_WIFI_MODE_AP
        bool "AP mode (Access Point)"
    config DROWSY_WIFI_MODE_STA
        bool "STA mode (Station)"
    config DROWSY_WIFI_MODE_OFF
        bool "Disable WiFi"
    endchoice

    config DROWSY_AP_SSID
        string "AP SSID"
        default "Drowsy_AP"
        depends on DROWSY_WIFI_MODE_AP

    config DROWSY_AP_PASS
        string "AP password"
        default "12345678"
        depends on DROWSY_WIFI_MODE_AP

    config DROWSY_WIFI_SSID
        string "WiFi SSID (STA mode)"
        default "ESP32"
        depends on DROWSY_WIFI_MODE_STA

    config DROWSY_WIFI_PASS
        string "WiFi password (STA mode)"
        default ""
        depends on DROWSY_WIFI_MODE_STA

    config DROWSY_ADMIN_PASS
        string "Admin panel password"
        default "admin"
        depends on DROWSY_WEB_ENABLE

    config DROWSY_WEB_HTTP_PORT
        int "HTTP port"
        default 80
        depends on DROWSY_WEB_ENABLE

    config DROWSY_WEB_STREAM_PORT
        int "Stream port (MJPEG)"
        default 81
        depends on DROWSY_WEB_ENABLE

    config DROWSY_WEB_JPEG_QUALITY
        int "Stream JPEG quality (0-100)"
        default 35
        range 20 90
        depends on DROWSY_WEB_ENABLE

    config DROWSY_WEB_STREAM_SKIP
        int "Stream frame skip"
        default 1
        range 1 10
        depends on DROWSY_WEB_ENABLE

    # ----------------------------------------------------------
    # AI Execution Source
    # ----------------------------------------------------------
    config DROWSY_AI_ON_DEVICE
        bool "Run edge AI pipeline on ESP32"
        default y
        help
            y: ESP32 runs face detection + PFLD + state machine on-device.
            n: ESP32 only streams frames to app.

    # ----------------------------------------------------------
    # Reporting
    # ----------------------------------------------------------
    config DROWSY_REPORT_ENABLE
        bool "Enable report to Admin Server"
        default y
        depends on DROWSY_WEB_ENABLE && DROWSY_WIFI_MODE_STA

    config DROWSY_REPORT_URL
        string "Admin Server URL"
        default "http://192.168.1.100:5000/api/report"
        depends on DROWSY_REPORT_ENABLE

    config DROWSY_DEVICE_ID
        string "Device ID"
        default ""
        depends on DROWSY_REPORT_ENABLE

    config DROWSY_DRIVER_NAME
        string "Driver name"
        default ""
        depends on DROWSY_REPORT_ENABLE

    config DROWSY_LOCATION
        string "Vehicle location"
        default ""
        depends on DROWSY_REPORT_ENABLE

endmenu
```
